## main/Kconfig.projbuild
```kconfig
menu "WiFi Configuration"
    config WIFI_SSID
        string "WiFi SSID"
        default "your-ssid"

    config WIFI_PASSWORD
        string "WiFi Password"
        default "your-password"
endmenu
```
